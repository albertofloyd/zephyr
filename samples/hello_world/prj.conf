## prj.conf
```kconfig
# Enable external crystal, default is internal oscillator
CONFIG_SOC_MEC1501_EXT_32K=n
CONFIG_SOC_MEC1501_EXT_32K_CRYSTAL=n
CONFIG_SOC_MEC1501_EXT_32K_PARALLEL_CRYSTAL=n

CONFIG_32KHZ_CLOCK_DEBUG=y
```

## src/main.c
```c
/*
 * Copyright (c) 2012-2014 Wind River Systems, Inc.
 *
 * SPDX-License-Identifier: Apache-2.0
 */

#include <stdio.h>

int main(void)
{
	printf("Hello World! %s\n", CONFIG_BOARD_TARGET);

	while (1) {
		printk(".");
		printf("x");
	};

	return 0;
}
```
