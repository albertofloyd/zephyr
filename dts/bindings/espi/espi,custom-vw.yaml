## dts/bindings/espi/espi,custom-vw.yaml
```yaml
# Copyright (c) 2019 Intel Corporation
# SPDX-License-Identifier: Apache-2.0

description: ESPI controller

compatible: "espi,custom-vw"

properties:
    vw_index:
      type: int
      description: The unused virtual wire slot specification, it should not
          clash with the index of the pre-defined groups of virtual wires.
          See Table 9, section 5.2.2.1 from eSPI spec.
      required: true

    vw_initial_value:
      type: int
      description: The initial value of the virtual wire group, which defines
          the value of each of the individual wires packed in the group.
      required: true
```

## dts/bindings/espi/microchip,xec-espi-custom-vw.yaml
```yaml
# Copyright (c) 2019 Intel Corporation
# SPDX-License-Identifier: Apache-2.0

description: Microchip ESPI controller

compatible: "microchip,xec-espi-custom-vw"

include: espi,custom-vw.yaml

properties:
    reg:
      type: int
      description: eSPI virtual hw block register to be used for custom virtual
        wire group. This should not clash with registers already used.
        virtual wires.
      required: true

    src_bit:
      type: int
      description: Bit index within the eSPI virtual wire group.
```

## dts/bindings/espi/microchip,xec-espi.yaml
```yaml
# Copyright (c) 2019 Intel Corporation
# SPDX-License-Identifier: Apache-2.0

description: Microchip ESPI controller

compatible: "microchip,xec-espi"

include: espi-controller.yaml

properties:
    reg:
      description: mmio register space
      required: true

    io_girq:
      type: int
      description: soc group irq index for eSPI I/O
      required: true

    vw_girq:
      type: int
      description: soc group irq index for eSPI virtual wires channel
      required: true

    pc_girq:
      type: int
      description: soc group irq index for eSPI peripheral channel
      required: true

    custom_vws:
      type: phandle-array
      required: false
      description: |
          Additional custom virtual wires that can be sent over eSPI bus.
          These in addition to the pre-defined (canonical) system and platform
          signals already included in the eSPI specification.
          Both eSPI master and eSPI slave should define the custom wires with
          the same index and same bitmap.
```
